## launcher/main/Kconfig.projbuild
```kconfig
menu "Launcher experimental rendering"
config LX_USE_ORTHO
    bool "Experimental external lv_draw_ortho home renderer (Tab5)"
    default n
    help
        Use the external registry component with a private native-orientation
        RGB565 buffer. The compositor still owns the panel. Not a release.
config LX_ORTHO_TWO_CORES
    bool "Experimental second Ortho render core"
    depends on LX_USE_ORTHO && LV_OS_FREERTOS
    default n
    help
        Attempt to enable the helper only if the internal heap reserve permits.
        Requires hardware measurement; one core remains the default.
config LX_ORTHO_NATIVE
    bool "Experimental native triple framebuffer Ortho (Tab5)"
    depends on LX_USE_ORTHO
    default n
    help
        Tab5 allocates three native DSI buffers. LVGL FULL renders directly
        into a leased hidden buffer; other boards keep their private path.
        Experimental; requires hardware acceptance before release.
config LX_ORTHO_DIRECT
    bool "Experimental native DIRECT damage synchronization"
    depends on LX_ORTHO_NATIVE
    default n
    help
        Retain the FULL mode as a reference. Synchronize only stale native
        tiles before rendering changed LVGL regions. Rebootstrap with a
        full redraw after app/overlay ownership changes or failed frames.
config LX_ORTHO_LIFECYCLE
    bool "Experimental Ortho resource suspension before app load"
    depends on LX_ORTHO_DIRECT
    default n
    help
        Requires experimental engine API staged with tools/stage_ortho_lifecycle.sh.
        Suspend before allocating PAPP_FAST; resume on return or load failure.
endmenu
```
